## Kconfig
```kconfig
mainmenu "Ellu's Modules"

menu "Global Configuration"

    choice
        prompt "Target Compiler"
        help
            Select the compiler you are using.
        default MOD_CFG_COMPILER_AC6

        config MOD_CFG_COMPILER_AC6
            bool "AC6"
        config MOD_CFG_COMPILER_AC5
            bool "AC5"
        config MOD_CFG_COMPILER_GCC
            bool "GCC"
        config MOD_CFG_COMPILER_IAR
            bool "IAR"
    endchoice

    choice
        prompt "Target CPU"
        help
            Select the cpu you are using.
        default MOD_CFG_CPU_CM4

        config MOD_CFG_CPU_CM0
            bool "Cortex-M0"
        config MOD_CFG_CPU_CM3
            bool "Cortex-M3"
        config MOD_CFG_CPU_CM4
            bool "Cortex-M4"
        config MOD_CFG_CPU_CM7
            bool "Cortex-M7"
        config MOD_CFG_CPU_CM33
            bool "Cortex-M33"
        config MOD_CFG_CPU_ARM7
            bool "ARM7"
        config MOD_CFG_CPU_ARM9
            bool "ARM9"
    endchoice

    choice
        prompt "Enable RTOS Support"
        help
            Select the RTOS you are using.
        default MOD_CFG_USE_OS_NONE
        config MOD_CFG_USE_OS_NONE
            bool "None"
        config MOD_CFG_USE_OS_FREERTOS
            bool "FreeRTOS"
        config MOD_CFG_USE_OS_RTT
            bool "RT-Thread"
        config MOD_CFG_USE_OS_KLITE
            bool "KLite RTOS"
            select MOD_ENABLE_KLITE
    endchoice

    choice
        prompt "System Time/Tick Provider"
        help
            Select the system time source that offers m_tick/m_time_* functions.
        default MOD_CFG_TIME_MATHOD_KLITE if MOD_CFG_USE_OS_KLITE
        default MOD_CFG_TIME_MATHOD_PERF_COUNTER
        config MOD_CFG_TIME_MATHOD_HAL
            bool "ST HAL Library"
        config MOD_CFG_TIME_MATHOD_PERF_COUNTER
            bool "PerfCounter Library"
            select MOD_ENABLE_PERF_COUNTER
        config MOD_CFG_TIME_MATHOD_KLITE
            bool "KLite RTOS"
            depends on MOD_CFG_USE_OS_KLITE
        config MOD_CFG_TIME_MATHOD_FREERTOS
            bool "FreeRTOS"
            depends on MOD_CFG_USE_OS_FREERTOS
        config MOD_CFG_TIME_MATHOD_RTT
            bool "RT-Thread"
            depends on MOD_CFG_USE_OS_RTT
        config MOD_CFG_TIME_MATHOD_CUSTOM
            bool "Custom"
            help
                Implement following functions on your own:
                void mod_custom_tick_init(void);
                m_time_t mod_custom_tick_get(void);
                m_time_t mod_custom_tick_clk(void); (if dynamic tick frequency)
    endchoice

    menu "Custom Time/Tick Provider Configuration"
        depends on MOD_CFG_TIME_MATHOD_CUSTOM
        config MOD_CFG_CUSTOM_TIME_IMPORT
            bool "Custom Include"
            default n
            help
                If you have a include file needed by your custom time provider.
        config MOD_CFG_CUSTOM_TIME_HEADER
            depends on MOD_CFG_CUSTOM_TIME_IMPORT
            string "Custom Header File"
            help
                The header file that contains the custom time/tick provider definitions.
        choice
            prompt "Time Type"
            help
                Select the type of time you are using.
            config MOD_CFG_CUSTOM_TIME_TYPE_U32
                bool "uint32_t"
            config MOD_CFG_CUSTOM_TIME_TYPE_U64
                bool "uint64_t"
            config MOD_CFG_CUSTOM_TIME_TYPE_S32
                bool "int32_t"
            config MOD_CFG_CUSTOM_TIME_TYPE_S64
                bool "int64_t"
        endchoice

        config MOD_CFG_CUSTOM_TIME_BASE_DYNAMIC
            bool "Dynamic Tick Frequency"
            default n
            help
                If enabled, the tick frequency can be get from custom function:
                m_time_t mod_custom_tick_clk(void);
        config MOD_CFG_CUSTOM_TIME_BASE
            int "Tick Frequency"
            default 1000
            depends on !MOD_CFG_CUSTOM_TIME_BASE_DYNAMIC
            help
                The tick frequency in Hz.
    endmenu

    choice
        prompt "System Delay Provider"
        help
            Select the system delay source that offers m_delay_* functions.
            Be aware that if you are using an RTOS, the RTOS's delay functions should best be used.
        default MOD_CFG_DELAY_MATHOD_RTT if MOD_CFG_USE_OS_RTT
        default MOD_CFG_DELAY_MATHOD_KLITE if MOD_CFG_USE_OS_KLITE
        default MOD_CFG_DELAY_MATHOD_FREERTOS if MOD_CFG_USE_OS_FREERTOS
        default MOD_CFG_DELAY_MATHOD_PERF_COUNTER

        config MOD_CFG_DELAY_MATHOD_HAL
            bool "ST HAL Library"
        config MOD_CFG_DELAY_MATHOD_PERF_COUNTER
            bool "PerfCounter Library"
            select MOD_ENABLE_PERF_COUNTER
        config MOD_CFG_DELAY_MATHOD_RTT
            bool "RT-Thread"
            depends on MOD_CFG_USE_OS_RTT
        config MOD_CFG_DELAY_MATHOD_KLITE
            bool "KLite RTOS"
            depends on MOD_CFG_USE_OS_KLITE
        config MOD_CFG_DELAY_MATHOD_FREERTOS
            bool "FreeRTOS"
            depends on MOD_CFG_USE_OS_FREERTOS
        config MOD_CFG_DELAY_MATHOD_CUSTOM
            bool "Custom"
            help
                Implement following functions on your own:
                void mod_custom_delay_init(void);
                void mod_custom_delay_us(m_time_t us);
                void mod_custom_delay_ms(m_time_t ms);
    endchoice

    menu "Custom Delay Provider Configuration"
        depends on MOD_CFG_DELAY_MATHOD_CUSTOM
        config MOD_CFG_CUSTOM_DELAY_IMPORT
            bool "Custom Include"
            default n
            help
                If you have a custom include file needed by your custom delay provider.
        config MOD_CFG_CUSTOM_DELAY_HEADER
            depends on MOD_CFG_CUSTOM_DELAY_IMPORT
            string "Custom Header File"
            help
                The header file that contains the custom delay provider definitions.
    endmenu

    choice
        prompt "System Heap Provider"
        help
            Select the memory manager that offers m_alloc/m_free/m_realloc functions.
            Be aware that if you are using an RTOS, the RTOS's memory manager should best be used.
        default MOD_CFG_HEAP_MATHOD_KLITE if MOD_CFG_USE_OS_KLITE
        default MOD_CFG_HEAP_MATHOD_FREERTOS if MOD_CFG_USE_OS_FREERTOS
        default MOD_CFG_HEAP_MATHOD_RTT if MOD_CFG_USE_OS_RTT
        default MOD_CFG_HEAP_MATHOD_STDLIB

        config MOD_CFG_HEAP_MATHOD_STDLIB
            bool "Standard Library (stdlib.h)"
        config MOD_CFG_HEAP_MATHOD_LWMEM
            bool "LwMEM Memory Manager"
            select MOD_ENABLE_LWMEM
        config MOD_CFG_HEAP_MATHOD_HEAP4
            bool "Heap4 Memory Manager (modified from FreeRTOS)"
            select MOD_ENABLE_HEAP4
        config MOD_CFG_HEAP_MATHOD_KLITE
            bool "KLite RTOS Memory Manager"
            depends on MOD_CFG_USE_OS_KLITE
        config MOD_CFG_HEAP_MATHOD_FREERTOS
            bool "FreeRTOS Memory Manager"
            depends on MOD_CFG_USE_OS_FREERTOS
        config MOD_CFG_HEAP_MATHOD_RTT
            bool "RT-Thread Memory Manager"
            depends on MOD_CFG_USE_OS_RTT
        config MOD_CFG_HEAP_MATHOD_CUSTOM
            bool "Custom"
            help
                Implement following functions on your own:
                void mod_custom_heap_init(void* ptr, size_t size);
                void *mod_custom_alloc(size_t size);
                void mod_custom_free(void *ptr);
                void *mod_custom_realloc(void *ptr, size_t size);
    endchoice

    menu "Custom Heap Provider Configuration"
        depends on MOD_CFG_HEAP_MATHOD_CUSTOM
        config MOD_CFG_CUSTOM_HEAP_IMPORT
            bool "Custom Include"
            default n
            help
                If you have a custom include file needed by your custom heap provider.
        config MOD_CFG_CUSTOM_HEAP_HEADER
            depends on MOD_CFG_CUSTOM_HEAP_IMPORT
            string "Custom Header File"
            help
                The header file that contains the custom heap provider definitions.
    endmenu

    config MOD_CFG_ENABLE_ATOMIC
        bool "Enable Atomic Operations Support"
        help
            If enabled, the atomic operations will be used to protect critical sections.
            This will make the system more stable without using a mutex or semaphore.
            May not be available on some platforms like Cortex-M0.
        default n if MOD_CFG_USE_OS_NONE
        default y


    config MOD_CFG_WFI_WHEN_SYSTEM_IDLE
        bool "Call WFI when system is idle"
        help
            If enabled, the system will enter WFI mode when there is no task to run.
            This will save power, but may cause some peripherals to stop working and avoid Debugger from connecting.
            Effects KLite RTOS and Scheduler by now.
        default n

    config MOD_CFG_PLATFORM_HEADER
        string "Platform Header File"
        help
            The header file that contains the platform specific definitions.
            This file should be included in the main.c file.
        default "\"main.h\""

endmenu


# Sub-Modules
source "*/Kconfig"
```

## algorithm/Kconfig
```kconfig
menu "Algorithm Modules"

menuconfig MOD_ENABLE_CMSIS_DSP
bool "CMSIS-DSP (Source code from ARM)"
default n

menuconfig MOD_ENABLE_LIBCRC
bool "LibCRC (CRC Checksum Library)"
default n

menuconfig MOD_ENABLE_PID
bool "PID (Closed-Loop Control)"
default n

menuconfig MOD_ENABLE_QUATERNION
bool "Quaternion (Pose Estimation)"
default n

endmenu
```

## communication/Kconfig
```kconfig
menu "Communication Modules"

menuconfig MOD_ENABLE_CHERRYUSB
bool "CherryUSB"
default n

menuconfig MOD_ENABLE_LWPKT
bool "LWPkt (Lightweight Packet)"
select MOD_ENABLE_LWRB
default n

menuconfig MOD_ENABLE_MINMEA
bool "MinMEA (Minimal NMEA Parser)"
default n

menuconfig MOD_ENABLE_MODBUS
bool "Modbus"
select MOD_ENABLE_LOG
default n

menuconfig MOD_ENABLE_TINYFRAME
bool "TinyFrame"
default n
if MOD_ENABLE_TINYFRAME
source "communication/TinyFrame/Kconfig"
endif

menuconfig MOD_ENABLE_XYMODEM
bool "XYModem (File Transfer Protocol)"
select MOD_ENABLE_LOG
default n

endmenu
```

## communication/TinyFrame/Kconfig
```kconfig
menu "TinyFrame Configuration"

config TF_ID_BYTES
    int "Part ID: Byte Num"
    default 1
    range 1 4
    help
      The number of bytes to use for the ID field in the TinyFrame protocol (must in 1, 2, 4).

config TF_LEN_BYTES
    int "Part Length: Byte Num"
    default 2
    range 1 4
    help
      The number of bytes to use for the Length field in the TinyFrame protocol (must in 1, 2, 4).

config TF_TYPE_BYTES
    int "Part Type: Byte Num"
    default 1
    range 1 4
    help
      The number of bytes to use for the Type field in the TinyFrame protocol (must in 1, 2, 4).

config TF_USE_SOF_BYTE
    bool "Part SOF: Enable"
    default y
    help
      Use the Start of Frame byte in the TinyFrame protocol.

config TF_SOF_BYTE
    hex "Part SOF: Byte Value"
    default 0x7E
    range 0 255
    depends on TF_USE_SOF_BYTE
    help
      The Start of Frame byte in the TinyFrame protocol.

choice
    prompt "Part CKSUM: Type"
    default TF_CKSUM_TYPE_CRC16
    config TF_CKSUM_TYPE_NONE
        bool "None"
    config TF_CKSUM_TYPE_XOR
        bool "XOR"
    config TF_CKSUM_TYPE_CRC8
        bool "CRC-8"
    config TF_CKSUM_TYPE_CRC16
        bool "CRC-16"
    config TF_CKSUM_TYPE_CRC32
        bool "CRC-32"
    config TF_CKSUM_TYPE_CUSTOM8
        bool "Custom-8"
    config TF_CKSUM_TYPE_CUSTOM16
        bool "Custom-16"
    config TF_CKSUM_TYPE_CUSTOM32
        bool "Custom-32"
endchoice


config TF_TICKS_TYPE
    string "Type of TF_TICKS"
    default "uint32_t"
    help
      The type of TF_TICKS used for timeout tick counters - should be large enough for all used timeouts

config TF_COUNT_TYPE
    string "Type of TF_COUNT"
    default "uint16_t"
    help
      The type of TF_COUNT used in loops iterating over listeners

config TF_MAX_PAYLOAD_RX
    int "Maximum RX Payload Size"
    default 1024
    help
      Maximum received payload size (static buffer)
      Larger payloads will be rejected.

config TF_SENDBUF_LEN
    int "Send Buffer Length"
    default 128
    help
      Size of the sending buffer. Larger payloads will be split to pieces and sent
      in multiple calls to the write function. This can be lowered to reduce RAM
      usage.
      fine TF_SENDBUF_LEN 128

config TF_MAX_ID_LST
    int "Frame ID Listeners"
    default 10
    help
      Frame ID listeners (wait for response / multi-part message)

config TF_MAX_TYPE_LST
    int "Frame Type Listeners"
    default 10
    help
      Frame Type listeners (wait for frame with a specific first payload byte)

config TF_MAX_GEN_LST
    int "General Listeners"
    default 10
    help
      Generic listeners (fallback if no other listener catches it)

config TF_PARSER_TIMEOUT_TICKS
    int "Parser Timeout Ticks (ms)"
    default 10
    help
      Timeout for receiving & parsing a frame

config TF_USE_MUTEX
    bool "Use Mutex"
    default y
    depends on !MOD_CFG_USE_OS_NONE
    help
      Use a mutex to protect the TinyFrame state. This is required if TinyFrame is used in a multi-threaded environment.

endmenu
```

## datastruct/Kconfig
```kconfig
menu "DataStruct Modules"

menuconfig MOD_ENABLE_BTREE
bool "BTree (Binary Tree)"
default n

menuconfig MOD_ENABLE_CSTRING
bool "CString (C-style string)"
default n

menuconfig MOD_ENABLE_CTL
bool "CTL (Container Template Library)"
default n

menuconfig MOD_ENABLE_DLIST
bool "DList (Doubly Linked List)"
default n

menuconfig MOD_ENABLE_FIFOFAST
bool "FIFOFast (Fast FIFO Header File)"
default n

menuconfig MOD_ENABLE_HASHMAP
bool "HashMap (Hash Map)"
default n

menuconfig MOD_ENABLE_JSON
bool "JSON (Json Parser)"
default n

menuconfig MOD_ENABLE_LFBB
bool "LFBB (Lock Free Bipartite Buffer)"
default n

menuconfig MOD_ENABLE_LFIFO
bool "LFIFO (Lock Free FIFO)"
default n

menuconfig MOD_ENABLE_LINUX_LIST
bool "LinuxList (Linux Style List)"
default n

menuconfig MOD_ENABLE_LWRB
bool "LWRB (Lightweight Ring Buffer)"
default n

menuconfig MOD_ENABLE_PQUEUE
bool "PQueue (Priority Queue)"
default n

menuconfig MOD_ENABLE_SDS
bool "SDS (Simple Dynamic String)"
default n

menuconfig MOD_ENABLE_STRUCT2JSON
bool "Struct2Json (Struct to Json)"
default n

menuconfig MOD_ENABLE_UDICT
bool "UDict (Universal Dictionary)"
default n
select MOD_ENABLE_UTHASH

menuconfig MOD_ENABLE_ULIST
bool "UList (Universal Mem Continuous List)"

menuconfig MOD_ENABLE_UTHASH
bool "UTHash (Hash Table)"
default n

endmenu
```

## datastruct/lfbb/Kconfig
```kconfig
menu "LFBB Configuration"

config LFBB_DISABLE_ATOMIC
    bool "Disable atomic operations"
    default n

config LFBB_CACHELINE_LENGTH
    int "Cache line length"
    default 64

config LFBB_MULTICORE_HOSTED
    bool "Multicore hosted"
    default n

endmenu
```

## datastruct/lfifo/Kconfig
```kconfig
menu "LFifo Configuration"

config LFIFO_CFG_DISABLE_ATOMIC
    bool "Disable atomic operations"
    default n
    help
      If you say Y here, the atomic operations will be disabled.

config LFIFO_CFG_MEMCPY_FUNC
    string "memcpy function"
    default "memcpy"
    help
      The function to use for copying data. The default is the standard
      library memcpy function.

endmenu
```
