## debug/Kconfig
```kconfig
menu "Debug Modules"

menuconfig MOD_ENABLE_CM_BACKTRACE
bool "CmBacktrace (Call Stack Trace)"
select MOD_ENABLE_UNI_IO
default n
if MOD_ENABLE_CM_BACKTRACE
    source "debug/cm_backtrace/Kconfig"
endif

menuconfig MOD_ENABLE_COREMARK
bool "Coremark (Benchmark)"
select MOD_ENABLE_UNI_IO
select MOD_ENABLE_PERF_COUNTER
default n
if MOD_ENABLE_COREMARK
    source "debug/coremark/Kconfig"
endif

menuconfig MOD_ENABLE_LOG
bool "Log (Single Header Logger)"
select MOD_ENABLE_UNI_IO
select MOD_ENABLE_MACRO
default y
if MOD_ENABLE_LOG
    source "debug/log/Kconfig"
endif

menuconfig MOD_ENABLE_MINCTEST
bool "Minctest (Minimal Unit Test Framework)"
select MOD_ENABLE_LOG
default n

menuconfig MOD_ENABLE_RTT
bool "Segger RTT"
default n

endmenu
```

## debug/cm_backtrace/Kconfig
```kconfig
menu "CmBacktrace Configuration"

choice
    prompt "Using OS or Baremetal"
    default CMB_USING_BARE_METAL_PLATFORM if MOD_CFG_USE_OS_NONE
    default CMB_USING_OS_PLATFORM

    config CMB_USING_BARE_METAL_PLATFORM
        bool "Bare Metal"

    config CMB_USING_OS_PLATFORM
        depends on !MOD_CFG_USE_OS_NONE
        bool "OS"
endchoice

if CMB_USING_OS_PLATFORM
    choice
        prompt "OS Type"
        default CMB_OS_PLATFORM_USE_RTT if MOD_CFG_USE_OS_RTT
        default CMB_OS_PLATFORM_USE_FREERTOS if MOD_CFG_USE_OS_FREERTOS
        default CMB_OS_PLATFORM_USE_KLITE if MOD_CFG_USE_OS_KLITE
        default CMB_OS_PLATFORM_USE_UCOSII if MOD_CFG_USE_OS_UCOSII
        default CMB_OS_PLATFORM_USE_UCOSIII if MOD_CFG_USE_OS_UCOSIII
        default CMB_OS_PLATFORM_USE_RTX5 if MOD_CFG_USE_OS_RTX5
        default CMB_OS_PLATFORM_USE_FREERTOS

        config CMB_OS_PLATFORM_USE_FREERTOS
            bool "FreeRTOS"

        config CMB_OS_PLATFORM_USE_RTT
            bool "RT-Thread"

        config CMB_OS_PLATFORM_USE_UCOSII
            bool "uC/OS-II"

        config CMB_OS_PLATFORM_USE_UCOSIII
            bool "uC/OS-III"

        config CMB_OS_PLATFORM_USE_RTX5
            bool "RTX5"

        config CMB_OS_PLATFORM_USE_KLITE
            bool "Klite"
    endchoice
endif

choice
    prompt "CPU Platform"
    default CMB_CPU_USE_ARM_CORTEX_M4

    config CMB_CPU_USE_ARM_CORTEX_M0
        bool "ARM Cortex-M3"

    config CMB_CPU_USE_ARM_CORTEX_M3
        bool "ARM Cortex-M3"

    config CMB_CPU_USE_ARM_CORTEX_M4
        bool "ARM Cortex-M4"

    config CMB_CPU_USE_ARM_CORTEX_M7
        bool "ARM Cortex-M7"

    config CMB_CPU_USE_ARM_CORTEX_M33
        bool "ARM Cortex-M33"
endchoice


config CMB_USING_DUMP_STACK_INFO
    bool "Dump Stack Info"
    default n
choice
    prompt "Use Language"
    default CMB_PRINT_USE_ENGLISH

    config CMB_PRINT_USE_ENGLISH
        bool "English"

    config CMB_PRINT_USE_CHINESE
        bool "Chinese"
endchoice
endmenu
```

## debug/log/Kconfig
```kconfig
menuconfig LOG_CFG_ENABLE
bool "Enable Log Output"
default y
help
    Enable this option to configure the log module.

if LOG_CFG_ENABLE
    config LOG_CFG_ENABLE_TIMESTAMP
        bool "Enable Timestamp Output"
        default y
        help
        Enable this option to add a timestamp to the log output.
        e.g. "[INFO]:[0.123s]:Hello World"

    config LOG_CFG_ENABLE_COLOR
        bool "Enable Color Output"
        default y
        help
        Enable this option to add color to the log output.
        e.g. "\033[1;31m[ERROR]:Hello World\033[0m"

    config LOG_CFG_ENABLE_FUNC_LINE
        bool "Enable Function and Line Number Output"
        default n
        help
        Enable this option to add the function and line number to the log output.
        e.g. "[INFO]:[main.c:123]:Hello World"

    config LOG_CFG_ENABLE_ALIAS
        bool "Enable Alias for Log Functions"
        default n
        help
        Enable this option to add an alias for the log functions.
        e.g. LOG_E("Error") is the same as LOG_ERROR("Error").

    menu "Log Levels Config"
        config LOG_CFG_ENABLE_TRACE
            bool "Level: Trace"
            default y

        config LOG_CFG_ENABLE_DEBUG
            bool "Level: Debug"
            default y

        config LOG_CFG_ENABLE_PASS
            bool "Level: Pass"
            default y

        config LOG_CFG_ENABLE_INFO
            bool "Level: Info"
            default y

        config LOG_CFG_ENABLE_WARN
            bool "Level: Warning"
            default y

        config LOG_CFG_ENABLE_ERROR
            bool "Level: Error"
            default y

        config LOG_CFG_ENABLE_FATAL
            bool "Level: Fatal"
            default y

        config LOG_CFG_ENABLE_ASSERT
            bool "Level: Assert"
            default y
    endmenu

    menu "Log Colors Config"
        config LOG_CFG_R_COLOR
            string "Color: Trace"
            default "T_BLUE"

        config LOG_CFG_D_COLOR
            string "Color: Debug"
            default "T_CYAN"

        config LOG_CFG_P_COLOR
            string "Color: Pass"
            default "T_LGREEN"

        config LOG_CFG_I_COLOR
            string "Color: Info"
            default "T_GREEN"

        config LOG_CFG_W_COLOR
            string "Color: Warning"
            default "T_YELLOW"

        config LOG_CFG_E_COLOR
            string "Color: Error"
            default "T_RED"

        config LOG_CFG_F_COLOR
            string "Color: Fatal"
            default "T_MAGENTA"

        config LOG_CFG_A_COLOR
            string "Color: Assert"
            default "T_RED"

        config LOG_CFG_T_COLOR
            string "Color: Timeit"
            default "T_YELLOW"
    endmenu

    menu "Log String Config"
        config LOG_CFG_R_STR
            string "String: Trace"
            default "\"TRACE\""

        config LOG_CFG_D_STR
            string "String: Debug"
            default "\"DEBUG\""

        config LOG_CFG_P_STR
            string "String: Pass"
            default "\"PASS\""

        config LOG_CFG_I_STR
            string "String: Info"
            default "\"INFO\""

        config LOG_CFG_W_STR
            string "String: Warning"
            default "\"WARN\""

        config LOG_CFG_E_STR
            string "String: Error"
            default "\"ERROR\""

        config LOG_CFG_F_STR
            string "String: Fatal"
            default "\"FATAL\""

        config LOG_CFG_A_STR
            string "String: Assert"
            default "\"ASSERT\""

        config LOG_CFG_T_STR
            string "String: Timeit"
            default "\"TIMEIT\""
    endmenu

    menu "Advanced Configuration"
        config LOG_CFG_PRINTF
            string "Log Printf Function"
            default "printf"
            help
            The function to use for log output.

        config LOG_CFG_TIMESTAMP_FMT
            string "Log Timestamp Format"
            default "\"%.3fs\""
            help
            The format string to use for the timestamp (same as printf).

        config LOG_CFG_TIMESTAMP_FUNC
            string "Log Timestamp Format Function"
            default "((float)((uint64_t)m_time_ms()) / 1000)"
            help
            The function to use for acquiring the timestamp (offers parmeters for the timestamp format).

        config LOG_CFG_PREFIX
            string "Log Prefix"
            default "\"\""
            help
            The prefix to use for the log output.
            e.g. "\r" to move the cursor to the beginning of the line.

        config LOG_CFG_SUFFIX
            string "Log Suffix"
            default "\"\""
            help
            The suffix to use for the log output.
            e.g. "\033[K" to clear the line and move the cursor to the beginning of the next line.

        config LOG_CFG_NEWLINE
            string "Log Newline"
            default "\"\\r\\n\""
            help
            The newline to use for the log output.
            e.g. "\r\n" to move the cursor to the beginning of the next line.

        config LOG_CFG_ENABLE_HOOK
            bool "Enable Log Hook"
            default n
            help
            Enable this option to add a hook for the log output.
            e.g. to send the log output to a file.
            To use this, you should define a function: void log_hook(const char *fmt, ...)
    endmenu
endif
```

## driver/Kconfig
```kconfig
menu "Driver Modules"

menuconfig MOD_ENABLE_BQ25890
    bool "BQ25890 (Charger Controller)"
    default n

menuconfig MOD_ENABLE_EE24
    bool "EE24 (EE24 EEPROM)"
    default n

menuconfig MOD_ENABLE_KEY
    bool "Key (Universal Key)"
    default n

menuconfig MOD_ENABLE_MOTOR
    bool "Motor (Closed-loop Motor)"
    select MOD_ENABLE_MACRO
    select MOD_ENABLE_PID
    default n

menuconfig MOD_ENABLE_PAJ7620U2
    bool "PAJ7620U2 (Gesture Recognition)"
    default n

menuconfig MOD_ENABLE_SC7A20
    bool "SC7A20 (Accelerometer)"
    select MOD_ENABLE_LOG
    default n

menuconfig MOD_ENABLE_SH2
    bool "SH2 (SH2 Sensorhub Protocol)"
    default n

menuconfig MOD_ENABLE_SPIF
    bool "SPIF (SPI Flash)"
    select MOD_ENABLE_LOG
    default n

menuconfig MOD_ENABLE_STEPPER
    bool "Stepper (Stepper Motor)"
    select MOD_ENABLE_LOG
    default n

menuconfig MOD_ENABLE_VL53L0X
    bool "VL53L0X (Time-of-Flight Distance Sensor)"
    select MOD_ENABLE_LOG
    default n

menuconfig MOD_ENABLE_WS2812_SPI
    bool "WS2812 (RGB LED DMA-SPI Driver)"
    select MOD_ENABLE_LOG
    default n

endmenu
```

## graphics/Kconfig
```kconfig
menu "Graphics Modules"

menuconfig MOD_ENABLE_EASY_UI
    bool "EasyUI (Single Color UI Framework)"
    select MOD_ENABLE_LOG
    default n

menuconfig MOD_ENABLE_HAGL
    bool "HAGL (HAL Graphics Layer)"
    default n

menuconfig MOD_ENABLE_LVGL
    bool "LVGL (Embedded Graphics Library)"
    default n
if MOD_ENABLE_LVGL
    source "graphics/lvgl/Kconfig"

    menuconfig MOD_ENABLE_LVGL_GAUSSIAN_BLUR
        bool "LVGL Gaussian Blur"
        default n

    menuconfig MOD_ENABLE_LVGL_PM
        bool "LVGL Page Manager"
        default n

endif

menuconfig MOD_ENABLE_U8G2
    bool "U8G2 (Monochrome Display Library)"
    default n

menuconfig MOD_ENABLE_UGUI
    bool "UGUI (Universal Graphic Library)"
    default n
if MOD_ENABLE_UGUI
    source "graphics/ugui/Kconfig"
endif

menuconfig MOD_ENABLE_VIRTUAL_LCD
    bool "Virtual LCD (For Simulation)"
    select MOD_ENABLE_UNI_IO
    select MOD_ENABLE_LOG
    default n

endmenu
```

## graphics/ugui/Kconfig
```kconfig
menu "µGUI configuration"

choice
    prompt "Color Format"
    default UGUI_CFG_USE_COLOR_RGB565
    help
      Select the color format for the µGUI library.

    config UGUI_CFG_USE_COLOR_RGB565
        bool "RGB565"

    config UGUI_CFG_USE_COLOR_RGB888
        bool "RGB888"
endchoice

menu "Enable/Disable Fonts"
    config UGUI_CFG_USE_FONT_4X6
        bool "4x6"
        default n

    config UGUI_CFG_USE_FONT_5X8
        bool "5x8"
        default n

    config UGUI_CFG_USE_FONT_5X12
        bool "5x12"
        default n

    config UGUI_CFG_USE_FONT_6X8
        bool "6x8"
        default n

    config UGUI_CFG_USE_FONT_6X10
        bool "6x10"
        default n

    config UGUI_CFG_USE_FONT_7X12
        bool "7x12"
        default n

    config UGUI_CFG_USE_FONT_8X8
        bool "8x8"
        default n

    config UGUI_CFG_USE_FONT_8X12_CYRILLIC
        bool "8x12_cyrillic"
        default n

    config UGUI_CFG_USE_FONT_8X12
        bool "8x12"
        default n

    config UGUI_CFG_USE_FONT_8X14
        bool "8x14"
        default n

    config UGUI_CFG_USE_FONT_10X16
        bool "10x16"
        default n

    config UGUI_CFG_USE_FONT_12X16
        bool "12x16"
        default n

    config UGUI_CFG_USE_FONT_12X20
        bool "12x20"
        default n

    config UGUI_CFG_USE_FONT_16X26
        bool "16x26"
        default n

    config UGUI_CFG_USE_FONT_22X36
        bool "22x36"
        default n

    config UGUI_CFG_USE_FONT_24X40
        bool "24x40"
        default n

    config UGUI_CFG_USE_FONT_32X53
        bool "32x53"
        default n
endmenu

endmenu
```

## nn/Kconfig
```kconfig
menu "NN Modules"

menuconfig MOD_ENABLE_GENANN
    bool "Genann (Simple Neural Network Library)"
    select MOD_ENABLE_LOG
    default n

endmenu
```

## peripheral/Kconfig
```kconfig
menu "Peripheral Modules"

menuconfig MOD_ENABLE_BOARD_I2C
    bool "(On)Board I2C"
    default n
if MOD_ENABLE_BOARD_I2C
source "peripheral/board_i2c/Kconfig"
endif

menuconfig MOD_ENABLE_BOARD_LED
    bool "(On)Board LED"
    default n
if MOD_ENABLE_BOARD_LED
source "peripheral/board_led/Kconfig"
endif

menuconfig MOD_ENABLE_EE
    bool "EE (EEPROM Emulation with Internal Flash)"
    default n

menuconfig MOD_ENABLE_I2C_SLAVE
    bool "I2C Slave (LL Library Only)"
    default n

menuconfig MOD_ENABLE_LL_I2C
    bool "LL I2C Library (Poll/Interrupt)"
    default n
if MOD_ENABLE_LL_I2C
source "peripheral/ll_i2c/Kconfig"
endif

menuconfig MOD_ENABLE_MR_LIBRARY
    bool "MR-Library"
    default n
if MOD_ENABLE_MR_LIBRARY
source "peripheral/mr_library/Kconfig"
endif

menuconfig MOD_ENABLE_SW_I2C
    bool "Software I2C (Bit-Bang)"
    default n

menuconfig MOD_ENABLE_SW_SPI
    bool "Software SPI (Bit-Bang)"
    default n

menuconfig MOD_ENABLE_UNI_IO
    bool "Uni-IO (Unified I/O Interface)"
    default y
    select MOD_ENABLE_LFBB
    select MOD_ENABLE_LFIFO
    select MOD_ENABLE_ULIST
    select MOD_ENABLE_LWPRINTF
if MOD_ENABLE_UNI_IO
source "peripheral/uni_io/Kconfig"
endif


endmenu
```

## peripheral/board_i2c/Kconfig
```kconfig
menu "Board I2C Configuration"

choice
    prompt "I2C Bus Driver"
    config BOARD_I2C_CFG_USE_NONE
        bool "None"

    config BOARD_I2C_CFG_USE_SW_IIC
        bool "Software I2C"

    config BOARD_I2C_CFG_USE_LL_I2C
        bool "LL Library I2C"

    config BOARD_I2C_CFG_USE_HAL_I2C
        bool "HAL Library I2C"
endchoice
    config BOARD_I2C_CFG_SW_SCL_PORT
        string "SCL Port"
        default "GPIOB"
        depends on BOARD_I2C_CFG_USE_SW_IIC
    config BOARD_I2C_CFG_SW_SCL_PIN
        string "SCL Pin"
        default "GPIO_PIN_6"
        depends on BOARD_I2C_CFG_USE_SW_IIC
    config BOARD_I2C_CFG_SW_SDA_PORT
        string "SDA Port"
        default "GPIOB"
        depends on BOARD_I2C_CFG_USE_SW_IIC
    config BOARD_I2C_CFG_SW_SDA_PIN
        string "SDA Pin"
        default "GPIO_PIN_7"
        depends on BOARD_I2C_CFG_USE_SW_IIC
    config BOARD_I2C_CFG_LL_INSTANCE
        string "LL I2C Instance"
        default "I2C1"
        depends on BOARD_I2C_CFG_USE_LL_I2C
    config BOARD_I2C_CFG_HAL_INSTANCE
        string "HAL I2C Instance"
        default "hi2c1"
        depends on BOARD_I2C_CFG_USE_HAL_I2C
endmenu
```

## peripheral/board_led/Kconfig
```kconfig
menu "Board LED Configuration"

config LED_CFG_USE_PWM
    bool "Use PWM for LED"
    default n

if LED_CFG_USE_PWM
    config LED_CFG_R_HTIM
        string "Red LED Timer"
        default "htim1"

    config LED_CFG_R_CHANNEL
        string "Red LED Channel"
        default "TIM_CHANNEL_1"

    config LED_CFG_G_HTIM
        string "Green LED Timer"
        default "htim1"

    config LED_CFG_G_CHANNEL
        string "Green LED Channel"
        default "TIM_CHANNEL_2"

    config LED_CFG_B_HTIM
        string "Blue LED Timer"
        default "htim1"

    config LED_CFG_B_CHANNEL
        string "Blue LED Channel"
        default "TIM_CHANNEL_3"

    config LED_CFG_R_PULSE
        int "Red LED Max Pulse"
        default 1024

    config LED_CFG_G_PULSE
        int "Green LED Max Pulse"
        default 1024

    config LED_CFG_B_PULSE
        int "Blue LED Max Pulse"
        default 1024

    config LED_CFG_PWMN_OUTPUT
        bool "Use PWMN for LED"
        default n
endif

endmenu
```
