## peripheral/mr_library/driver/Kconfig
```kconfig
menu "Driver configure"

choice
    prompt "Board type"

    config MR_BOARD_STM32F103
        bool "STM32F103"

    config MR_BOARD_STM32F407
        bool "STM32F407"

    config MR_BOARD_STM32F411
        bool "STM32F411"

    config MR_BOARD_STM32H7B0
        bool "STM32H7B0"
endchoice

if MR_BOARD_STM32F103
    source "peripheral/mr_library/driver/stm32f103/Kconfig"
endif
if MR_BOARD_STM32F407
    source "peripheral/mr_library/driver/stm32f407/Kconfig"
endif
if MR_BOARD_STM32F411
    source "peripheral/mr_library/driver/stm32f411/Kconfig"
endif
if MR_BOARD_STM32H7B0
    source "peripheral/mr_library/driver/stm32h7b0/Kconfig"
endif

endmenu
```

## peripheral/uart_pack/Kconfig
```kconfig
menu "Uart Pack Configuration"

config UART_CFG_ENABLE_DMA_RX
    bool "Enable DMA Receive"
    default y
    help
      Enable DMA Receive for UART

config UART_CFG_ENABLE_FIFO_TX
    bool "Enable FIFO Transmit"
    default y
    help
      Enable FIFO Transmit for UART

if UART_CFG_ENABLE_FIFO_TX
    config UART_CFG_TX_TIMEOUT
        int "FIFO Transmit Timeout (ms)"
        default 5
        range -1 100
        help
          FIFO Transmit Size in ms (-1 for give up, 0 for no timeout)
endif

config UART_CFG_DCACHE_COMPATIBLE
    bool "Enable D-Cache Compatible (H7/F7 Only)"
    default n
    help
      Enable D-Cache Compatible for DMA operation

config UART_CFG_REWRITE_HANLDER
    bool "Rewrite Handler Functions"
    default y
    help
      Rewrite Handler Functions generated by CubeMX automatically

config UART_CFG_ENABLE_CDC
    bool "Enable USB CDC Support"
    default n
    help
      Enable USB Virtual COM Port (CDC) Support
if UART_CFG_ENABLE_CDC
    choice
        prompt "USB CDC Interface"
        default UART_CFG_CDC_USE_CUBEMX

        config UART_CFG_CDC_USE_CUBEMX
            bool "CubeMX"
            help
            Use CubeMX generated USB CDC Interface

        config UART_CFG_CDC_USE_CHERRY
            bool "Cherry USB"
            help
            Use Cherry USB CDC Interface
    endchoice

    config UART_CFG_CDC_TIMEOUT
        int "CDC Timeout (ms)"
        default 5
        range 0 100
        help
          CDC Timeout in ms (0 for give up)
endif

config UART_CFG_TX_USE_DMA
    bool "Use DMA for Transmit"
    default y
    help
      Use DMA for Transmit

config UART_CFG_TX_USE_IT
    bool "Use Interrupt for Transmit"
    default y
    help
      Use Interrupt for Transmit

config UART_CFG_TX_TIMEOUT
    default 5
    range -1 100
    help
      Transmit Timeout in ms (-1 for give up, 0 for no timeout)

config UART_CFG_PRINTF_REDIRECT
    bool "Enable Printf Redirect"
    default y
if UART_CFG_PRINTF_REDIRECT
    choice
        prompt "Printf Redirect To"
        default UART_CFG_PRINTF_USE_UART
        config UART_CFG_PRINTF_BLOCK
            bool "NULL (Disble printf)"
        config UART_CFG_PRINTF_USE_UART
            bool "UART"
        config UART_CFG_PRINTF_USE_RTT
            bool "SEGGER RTT"
        config UART_CFG_PRINTF_USE_CDC
            bool "USB CDC"
            depends on UART_CFG_ENABLE_CDC
        config UART_CFG_PRINTF_USE_ITM
            bool "ITM (SWO Debug)"
    endchoice
    config UART_CFG_PRINTF_UART_PORT
        string "Printf UART Port"
        default "huart1"
        depends on UART_CFG_PRINTF_USE_UART
    config UART_CFG_PRINTF_REDIRECT_PUTX
        bool "Redirect puts/putchar"
        default y
        depends on !UART_CFG_PRINTF_BLOCK
endif

config VOFA_CFG_ENABLE
    bool "Enable VOFA+ Support"
    default n
if VOFA_CFG_ENABLE
config VOFA_CFG_BUFFER_SIZE
    int "VOFA+ Float Buffer Size"
    default 32
    range 1 128
endif
endmenu
```

## peripheral/uni_io/Kconfig
```kconfig
menuconfig UIO_CFG_ENABLE_UART
    bool "UART Support"
    default y
    help
      Enable UART Support
if UIO_CFG_ENABLE_UART
    config UIO_CFG_UART_ENABLE_DMA_RX
        bool "Enable DMA Receive"
        default y
        help
        Enable DMA Receive for UART

    config UIO_CFG_UART_ENABLE_FIFO_TX
        bool "Enable FIFO Transmit"
        default y
        help
        Enable FIFO Transmit for UART

    if UIO_CFG_UART_ENABLE_FIFO_TX
        config UIO_CFG_UART_TX_TIMEOUT
            int "FIFO Transmit Timeout (ms)"
            default 5
            range -1 100
            help
            FIFO Transmit Size in ms (-1 for give up, 0 for no timeout)
    endif

    config UIO_CFG_UART_DCACHE_COMPATIBLE
        bool "Enable D-Cache Compatible (H7/F7 Only)"
        default n
        help
        Enable D-Cache Compatible for DMA operation

    config UIO_CFG_UART_TX_USE_DMA
        bool "Use DMA for Transmit"
        default y
        help
        Use DMA for Transmit

    config UIO_CFG_UART_TX_USE_IT
        bool "Use Interrupt for Transmit"
        default y
        help
        Use Interrupt for Transmit

    config UIO_CFG_UART_TX_TIMEOUT
        default 5
        range -1 100
        help
        Transmit Timeout in ms (-1 for give up, 0 for no timeout)

    config UIO_CFG_UART_REWRITE_HANLDER
        bool "Rewrite Handler Functions"
        default y
        help
        Rewrite Handler Functions generated by CubeMX automatically
endif

menuconfig UIO_CFG_ENABLE_CDC
    bool "USB CDC Support"
    default n
    help
      Enable USB Virtual COM Port (CDC) Support
if UIO_CFG_ENABLE_CDC
    choice
        prompt "USB CDC Interface"
        default UIO_CFG_CDC_USE_CUBEMX

        config UIO_CFG_CDC_USE_CUBEMX
            bool "CubeMX"
            help
                Use CubeMX generated USB CDC Interface

        config UIO_CFG_CDC_USE_CHERRY
            bool "Cherry USB"
            help
                Use Cherry USB CDC Interface
    endchoice

    config UIO_CFG_CDC_TIMEOUT
        int "CDC Timeout (ms)"
        default 5
        range 0 100
        help
          CDC Timeout in ms (0 for give up)
endif

menuconfig UIO_CFG_ENABLE_ITM
    bool "ITM Support"
    default n
    help
      Enable ITM (SWO Debug) Support

menuconfig UIO_CFG_PRINTF_REDIRECT
    bool "Printf Redirect"
    default y
if UIO_CFG_PRINTF_REDIRECT
    choice
        prompt "Printf Redirect To"
        default UIO_CFG_PRINTF_USE_UART
        config UIO_CFG_PRINTF_DISABLE
            bool "NULL (Disable printf)"
        config UIO_CFG_PRINTF_USE_UART
            bool "UART"
            depends on UIO_CFG_ENABLE_UART
        config UIO_CFG_PRINTF_USE_RTT
            bool "SEGGER RTT"
        config UIO_CFG_PRINTF_USE_CDC
            bool "USB CDC"
            depends on UIO_CFG_ENABLE_CDC
        config UIO_CFG_PRINTF_USE_ITM
            bool "ITM (SWO Debug)"
            depends on UIO_CFG_ENABLE_ITM
    endchoice
    config UIO_CFG_PRINTF_UART_PORT
        string "Printf UART Port"
        default "huart1"
        depends on UIO_CFG_PRINTF_USE_UART
    config UIO_CFG_PRINTF_REDIRECT_PUTX
        bool "Redirect puts/putchar/getchar"
        default y
        depends on !UIO_CFG_PRINTF_DISABLE
    config UIO_CFG_PRINTF_ENDL
        string "Printf End Line String"
        default "\"\\r\\n\""
        depends on !UIO_CFG_PRINTF_DISABLE
endif

menuconfig UIO_CFG_ENABLE_VOFA
    bool "VOFA+ Support"
    default n
if UIO_CFG_ENABLE_VOFA
config UIO_CFG_VOFA_BUFFER_SIZE
    int "VOFA+ Float Buffer Size"
    default 32
    range 1 128
endif
```

## storage/Kconfig
```kconfig
menu "Storage Modules"

menuconfig MOD_ENABLE_EASYFLASH
    bool "EasyFlash (Universal Flash Storage)"
    default n
    select MOD_ENABLE_STRUCT2JSON
if MOD_ENABLE_EASYFLASH
source "storage/easyflash/Kconfig"
endif

menuconfig MOD_ENABLE_LITTLEFS
    bool "LittleFS (Little Filesystem)"
    default n

menuconfig MOD_ENABLE_MINIFLASHDB
    bool "MiniFlashDB (Internal Flash Database)"
    default n
    imply MOD_ENABLE_EE

endmenu
```

## storage/easyflash/Kconfig
```kconfig
menu "EasyFlash Configuration"

config EF_BIG_ENDIAN
    bool "Big Endian"
    default n
    help
      MCU Endian Configuration, default is Little Endian Order

config EF_USING_ENV
    bool "Using ENV Feature"
    default y
    help
      using ENV function, default is NG (Next Generation) mode start from V4.0

if EF_USING_ENV

config EF_ENV_AUTO_UPDATE
    bool "Auto Update ENV"
    default n
    help
      Auto update ENV to latest default when current ENV version number is changed.

config EF_ENV_VER_NUM
    int "ENV Version Number"
    default 0
    help
      ENV version number, default is 0

config EF_USING_IAP
    bool "Using IAP Feature"
    default n
    help
      using IAP function

config EF_USING_LOG
    bool "Using LOG Feature"
    default n
    help
      using save log function

config EF_ERASE_MIN_SIZE
    hex "Erase Min Size"
    default 0x1000
    help
      The minimum size of flash erasure. May be a flash sector size

config EF_WRITE_GRAN
    hex "Write Granularity"
    default 0x1
    help
      the flash write granularity, unit: bit
      only support 1(nor flash)/ 8(stm32f4)/ 32(stm32f1)

config EF_READ_BUF_SIZE
    hex "Read Buffer Size"
    default 0x20
    help
      Larger numbers can improve first-time speed of alloc_env but require more stack space

config EF_START_ADDR
    hex "Start Address"
    default 0x0
    help
      The start address of easyflash area

config EF_ENV_AREA_SIZE
    hex "ENV Area Size"
    default 0x0 if !EF_USING_ENV
    default 0x2000
    help
      It's at least one empty sector for GC. So it's definition must more then or equal 2 * flash sector size.

config EF_LOG_AREA_SIZE
    hex "LOG Area Size"
    default 0x0 if !EF_USING_LOG
    default 0x1000
    help
      saved log area size

config EF_DEBUG_ENABLE
    bool "Print Debug"
    default n
    help
      Print debug information

endif

endmenu
```

## system/Kconfig
```kconfig
menu "System Modules"

menuconfig MOD_ENABLE_DALLOC
    bool "Dalloc (Dynamic Memory Allocator)"
    select MOD_ENABLE_LOG
    default n

menuconfig MOD_ENABLE_HEAP4
    bool "Heap4 (Separated from FreeRTOS)"
    default n

menuconfig MOD_ENABLE_KLITE
    bool "KLite (Kernel Lite RTOS)"
    select MOD_ENABLE_LOG
    default n
if MOD_ENABLE_KLITE
source "system/klite/Kconfig"
endif

menuconfig MOD_ENABLE_LWMEM
    bool "LwMem (Lightweight Memory Manager)"
    select MOD_ENABLE_LOG
    default n

menuconfig MOD_ENABLE_RTTHREAD_NANO
    bool "RT-Thread Nano"
    default n

menuconfig MOD_ENABLE_S_TASK
    bool "S-Task (Simple Coroutine Framework)"
    default n

menuconfig MOD_ENABLE_SCHEDULER
    bool "Scheduler (Task Scheduler)"
    default n
    select MOD_ENABLE_ULIST
    select MOD_ENABLE_LOG
    select MOD_ENABLE_MACRO
if MOD_ENABLE_SCHEDULER
source "system/scheduler/Kconfig"
endif

menuconfig MOD_ENABLE_SCHEDULER_LITE
    bool "Scheduler Lite"
    default n

endmenu
```
