## system/klite/Kconfig
```kconfig
config KLITE_CFG_FREQ
    int "Kernel Frequency"
    default 1000
    range 100 100000
    help
        The frequency of the kernel clock in Hz.

config KLITE_CFG_MAX_PRIO
    int "Max Priority"
    default 7
    range 1 31
    help
        The maximum priority level of the kernel.
        Available prio = 1 ~ Max Priority(include)
        Priority 0 is reserved for idle thread.

config KLITE_CFG_DEFAULT_PRIO
    int "Default Priority"
    default 4
    range 1 KLITE_CFG_MAX_PRIO
    help
        The default priority level of the thread created with prio=0.

choice
    prompt "Kernel Heap Provider"
    default KLITE_CFG_HEAP_USE_BUILTIN

    config KLITE_CFG_HEAP_USE_BUILTIN
        bool "Built-in (Suggested)"

    config KLITE_CFG_HEAP_USE_HEAP4
        select MOD_ENABLE_HEAP4
        bool "Third-Party: Heap4 (FreeRTOS)"

    config KLITE_CFG_HEAP_USE_LWMEM
        select MOD_ENABLE_LWMEM
        bool "Third-Party: LwMEM"
endchoice

menu "Built-in Heap Configuration"
    depends on KLITE_CFG_HEAP_USE_BUILTIN
    config KLITE_CFG_HEAP_USE_BESTFIT
        bool "Best Fit (or First Fit)"
        default y
        help
            Use the best fit algorithm to allocate memory.
            If not, use the first fit algorithm.
    config KLITE_CFG_HEAP_CLEAR_MEMORY_ON_FREE
        bool "Clear Memory on Free"
        default n
        help
            Clear the memory (fill 0x00) when the memory is freed or reallocated.

    config KLITE_CFG_HEAP_STORAGE_PREV_NODE
        bool "Storage Previous Memory Block Node"
        default y
        help
            Store the left node pointer in the memory block, making the time complexity for free() and realloc() to be O(1) but costing 4 bytes of memory more for each block.

    config KLITE_CFG_HEAP_ALIGN_BYTE
        int "Align Byte"
        default 4
        range 1 1024
        help
            The alignment of the memory block, which should be the power of 2. Default is 4 bytes for 32-bit CPU.
endmenu

config KLITE_CFG_ROUND_ROBIN
    bool "Round Robin Preemption"
    default y
    help
        Enable the round-robin preemption feature.
        Threads with the same priority will be scheduled in a round-robin manner even if the thread is not sleeping.

config KLITE_CFG_ROUND_ROBIN_SLICE
    bool "Custom Tick Slice"
    depends on KLITE_CFG_ROUND_ROBIN
    default n
    help
        Enable the round-robin custom slice time feature.
        The thread will be switched out after the user-defined slice time.

config KLITE_CFG_DEFAULT_STACK_SIZE
    int "Default Stack Size"
    default 1024
    range 1 1024000
    help
        The default stack size of the thread created with stack_size=0.

config KLITE_CFG_IDLE_THREAD_STACK_SIZE
    int "Idle Thread Stack Size"
    default 256
    range 256 1024000
    help
        The stack size of the idle thread.

config KLITE_CFG_STACK_OVERFLOW_DETECT
    bool "Enable Stack Overflow Detect"
    default n
    help
        Checking magic number barrier at both sides of the stack.
        Only available when the overflow have not caused a hard fault, and the thread can be switched out.
if KLITE_CFG_STACK_OVERFLOW_DETECT
choice
    prompt "Stack Overflow Behavior"
    default KLITE_CFG_STACKOF_BEHAVIOR_CALLBACK

    config KLITE_CFG_STACKOF_BEHAVIOR_CALLBACK
        bool "Callback [kl_stack_overflow_hook]"

    config KLITE_CFG_STACKOF_BEHAVIOR_SYSRESET
        bool "Reset System"

    config KLITE_CFG_STACKOF_BEHAVIOR_HARDFLT
        bool "Hard Fault (by accessing 0x10 address)"

    help
        The behavior when a stack overflow is detected.
endchoice

choice
    prompt "Stack Overflow Detect On"
    default KLITE_CFG_STACKOF_DETECT_ON_TASK_SWITCH

    config KLITE_CFG_STACKOF_DETECT_ON_TASK_SWITCH
        bool "Task Switch"

    config KLITE_CFG_STACKOF_DETECT_ON_TICK_INC
        bool "Tick Increment (High Cost)"

    help
        When to detect the stack overflow.
endchoice

config KLITE_CFG_STACKOF_SIZE
    int "Stack Overflow Barrier Size (uint32_t)"
    default 8
    range 1 128
    help
        The size of the barrier used to detect the stack overflow.
endif

choice
    prompt "Wait List Order by"
    default KLITE_CFG_WAIT_LIST_ORDER_BY_FIFO
    help
        The order in which tasks are selected from the wait list.
        Priority: Tasks with higher priority are selected first.
        FIFO: Tasks are selected in the order they were added to the wait list.

    config KLITE_CFG_WAIT_LIST_ORDER_BY_FIFO
        bool "FIFO"

    config KLITE_CFG_WAIT_LIST_ORDER_BY_PRIO
        bool "Priority"
endchoice

config KLITE_CFG_64BIT_TICK
    bool "64-bit Tick Variable (uint64_t)"
    default y
    help
        Use 64-bit (uint64_t) for tick variable, suggested when the system runs for a long time or the tick frequency is higher than 1000 Hz.

menuconfig KLITE_CFG_IPC_ENABLE
    bool "Optional Features"
    default y
if KLITE_CFG_IPC_ENABLE
    config KLITE_CFG_IPC_MUTEX
        bool "Mutex"
        default y
        help
            Mutex is a synchronization primitive that allows multiple threads to access a shared resource in a controlled manner. Only one thread can acquire the mutex at a time.

    config KLITE_CFG_IPC_SEM
        bool "Semaphore"
        default y
        help
            Semaphore is a synchronization primitive that allows multiple threads to access a shared resource in a controlled manner. Multiple threads can acquire the semaphore at the same time.

    config KLITE_CFG_IPC_COND
        bool "Condition Variable"
        default y
        help
            Condition variable is a synchronization primitive that allows threads to wait for a specific condition to be met before proceeding.

    config KLITE_CFG_IPC_BARRIER
        bool "Barrier"
        default n
        help
            Barrier allows multiple threads to synchronize at a specific point.

    config KLITE_CFG_IPC_RWLOCK
        bool "Read-Write Lock"
        default n
        select KLITE_CFG_IPC_MUTEX
        select KLITE_CFG_IPC_COND
        help
            Read-write lock allows multiple threads to read from a shared resource while preventing other threads from writing to the resource.

    config KLITE_CFG_IPC_EVENT
        bool "Event"
        default n
        help
            Event is a synchronization primitive that allows threads to wait for a specific event to occur before proceeding.

    config KLITE_CFG_IPC_EVENT_FLAGS
        bool "Event Flags"
        default n
        select KLITE_CFG_IPC_MUTEX
        select KLITE_CFG_IPC_COND
        help
            Event flags is a synchronization primitive that allows threads to wait for specific event bits to be set before proceeding. One event have 8 bits to set or clear.

    config KLITE_CFG_IPC_MAILBOX
        bool "Mailbox"
        default n
        select KLITE_CFG_IPC_MUTEX
        select KLITE_CFG_IPC_COND
        help
            Mailbox allows threads to send and receive data in a shared buffer.

    config KLITE_CFG_IPC_MPOOL
        bool "Memory Pool"
        select KLITE_CFG_IPC_MUTEX
        select KLITE_CFG_IPC_COND
        default n
        help
            Memory pool provides a way to allocate and release memory in a fixed size, while allowing threads to wait for available memory while the pool is empty.

    config KLITE_CFG_IPC_MQUEUE
        bool "Message Queue"
        default n
        select KLITE_CFG_IPC_MUTEX
        select KLITE_CFG_IPC_COND
        help
            Message queue allows threads to send and receive data in a shared buffer, in a FIFO manner.

    config KLITE_CFG_IPC_TIMER
        bool "Software Timer"
        default n
        select KLITE_CFG_IPC_MUTEX
        select KLITE_CFG_IPC_COND
        help
            Software timer provides a way to execute multiple functions at specific times, and in one thread.

    config KLITE_CFG_IPC_THREAD_POOL
        bool "Thread Pool"
        default n
        select KLITE_CFG_IPC_MQUEUE
        help
            Thread pool provides a manager to manage multiple threads, accepting tasks from the message queue and executing them.
endif

menu "Debug Options"
    config KLITE_CFG_TRACE_HEAP_OWNER
        bool "Trace Heap Memory Block Owner"
        default n
        depends on KLITE_CFG_HEAP_USE_BUILTIN
        help
            Trace the owner of each memory block. Cost 4 bytes of memory more for each block.

    config KLITE_CFG_TRACE_MUTEX_OWNER
        bool "Trace Mutex Owner"
        default n
        help
            Trace the owner of each mutex. Cost 4 bytes of memory more for each mutex.
endmenu
```

## system/scheduler/Kconfig
```kconfig
config SCH_CFG_ENABLE_TASK
    bool "Enable task Support"
    default y
    help
      Enable the task support in the scheduler.

if SCH_CFG_ENABLE_TASK

config SCH_CFG_COMP_RANGE_US
    int "Task Auto Compensate Range (us)"
    default 1000
    range 0 10000
    help
      The compensate range in us for the task scheduling.

config SCH_CFG_PRI_ORDER_ASC
    bool "Priority Order Ascending (Larger Priority First)"
    default y
    help
      The priority order is ascending if enabled.

endif

config SCH_CFG_ENABLE_EVENT
    bool "Enable event Support"
    default y
    help
      Enable the event support in the scheduler.

config SCH_CFG_ENABLE_COROUTINE
    bool "Enable Coroutine Support"
    default y
    help
      Enable the coroutine support in the scheduler.

config SCH_CFG_ENABLE_CALLLATER
    bool "Enable Call Later Support"
    default y
    help
      Enable the call later support in the scheduler.

if SCH_CFG_ENABLE_CALLLATER

config SCH_CFG_CALLLATER_MAX_ARG
    int "Max Argument Number"
    default 12
    range 1 64
    help
      The max argument number for the call later function.
      IF argument include uint64_t(or other 64bit type), it consumes 2 arguments.
endif

config SCH_CFG_ENABLE_SOFTINT
    bool "Enable Software Interrupt Support"
    default y
    help
      Enable the software interrupt support in the scheduler.

config SCH_CFG_STATIC_NAME
    bool "Use Static Name"
    default y
    help
      Use static name for the task, event, coroutine.

config SCH_CFG_STATIC_NAME_LEN
    int "Static Name Max Length"
    default 16
    range 8 64
    depends on SCH_CFG_STATIC_NAME
    help
      The max length of the static name (-1 for \0).

config SCH_CFG_DEBUG_REPORT
    bool "Enable Debug Report"
    default n
    help
      Enable the debug report in the scheduler. (Causing performance overhead)

if SCH_CFG_DEBUG_REPORT

config SCH_CFG_DEBUG_PERIOD
    int "Debug Report Period (s)"
    default 5
    range 1 60
    depends on SCH_CFG_DEBUG_REPORT
    help
      The debug report period in seconds. (best for < 10s)

config SCH_CFG_DEBUG_MAXLINE
    int "Debug Report Max Line"
    default 10
    range 1 1000
    depends on SCH_CFG_DEBUG_REPORT
    help
      The max line number of each debug report.

endif

config SCH_CFG_ENABLE_TERMINAL
    bool "Enable Terminal Support"
    default y
    help
      Enable the terminal support in the scheduler. (Depends on embedded-cli module)
```

## utility/Kconfig
```kconfig
menu "Utility Modules"

menuconfig MOD_ENABLE_COT_MENU
    bool "CotMenu"
    default n

menuconfig MOD_ENABLE_EMBEDDED_CLI
    bool "Embedded CLI (Command Line Interface)"
    default n

menuconfig MOD_ENABLE_INCBIN
    bool "IncBin (Binary File Inclusion)"
    default n

menuconfig MOD_ENABLE_LWPRINTF
    bool "LwPrintf (Lightweight Printf Implementation)"
    default y
if MOD_ENABLE_LWPRINTF
source "utility/lwprintf/Kconfig"
endif

menuconfig MOD_ENABLE_MACRO
    bool "Macro (Macro Utilities)"
    default y

menuconfig MOD_ENABLE_PERF_COUNTER
    bool "PerfCounter (Performance Counter)"
    default y

menuconfig MOD_ENABLE_RYU
    bool "Ryu (Fast Float-to-String Conversion)"
    default n

menuconfig MOD_ENABLE_TERM_TABLE
    bool "TermTable (Terminal Table Printer)"
    default n

menuconfig MOD_ENABLE_TIMELIB
    bool "TimeLib (UNIX Time Library)"
    default n

menuconfig MOD_ENABLE_TINY_REGEX
    bool "TinyRegex (Tiny Regular Expression Engine)"
    default n

menuconfig MOD_ENABLE_XV
    bool "XV (JavaScript-like Parser)"
    default n
    select MOD_ENABLE_RYU
    select MOD_ENABLE_JSON

endmenu
```

## utility/embedded_cli/KCONFIG
```kconfig
config EMCLI_CFG_LFS_UTILS
bool "LFS utilities"
select MOD_ENABLE_LOG
select MOD_ENABLE_LFS
default n

config EMCLI_CFG_LFS_ENABLE_YMODEM
bool "Enable YMODEM support"
depends on EMCLI_CFG_LFS_UTILS
select MOD_ENABLE_XYMODEM
default y

config EMCLI_CFG_LFS_ENABLE_DEBUG
bool "Enable debug output"
depends on EMCLI_CFG_LFS_UTILS
default n

config EMCLI_CFG_SYS_UTILS
bool "System utilities"
default n
select MOD_ENABLE_TERM_TABLE
```

## utility/lwprintf/Kconfig
```kconfig
menu "LwPrintf Configuration"

config LWPRINTF_CFG_SUPPORT_LONG_LONG
    bool "Support type: long long int ('%ll')"
    default y

config LWPRINTF_CFG_SUPPORT_TYPE_INT
    bool "Support type: int ('%d, %b, %u, %o, %i, %x')"
    default y

config LWPRINTF_CFG_SUPPORT_TYPE_POINTER
    bool "Support type: pointer ('%p')"
    default y

config LWPRINTF_CFG_SUPPORT_TYPE_FLOAT
    bool "Support type: float ('%f')"
    default y

config LWPRINTF_CFG_SUPPORT_TYPE_ENGINEERING
    bool "Support type: engineering ('%e')"
    default y

config LWPRINTF_CFG_SUPPORT_TYPE_STRING
    bool "Support type: string ('%s')"
    default y

config LWPRINTF_CFG_SUPPORT_TYPE_BYTE_ARRAY
    bool "Support type: byte array ('%k')"
    default y

config LWPRINTF_CFG_FLOAT_DEFAULT_PRECISION
    int "Default precision for float type"
    default 6
    depends on LWPRINTF_CFG_SUPPORT_TYPE_FLOAT

config LWPRINTF_CFG_ENABLE_SHORTNAMES
    bool "Enable short names"
    default y
    help
      It adds functions for default instance: `lwprintf`, `lwsnprintf` and others

config LWPRINTF_CFG_ENABLE_STD_NAMES
    bool "Enable standard names"
    default n
    help
      Disabled by default not to interfere with compiler implementation.
      Application may need to remove standard C STDIO library from linkage
      to be able to properly compile LwPRINTF with this option enabled
endmenu
```

## utility/xv/KCONFIG
```kconfig
config EMCLI_CFG_XV_EXTEND
bool "Enable extended XV support"
select MOD_ENABLE_LOG
select MOD_ENABLE_EMBEDDED_CLI
select MOD_ENABLE_UDICT
default n
```
